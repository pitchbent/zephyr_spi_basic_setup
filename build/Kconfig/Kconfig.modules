## build/Kconfig/Kconfig.modules
```kconfig
menu "canopennode (/Users/julius/zephyrproject/modules/lib/canopennode)"
osource "$(ZEPHYR_CANOPENNODE_KCONFIG)"
config ZEPHYR_CANOPENNODE_MODULE
	bool
	default y
endmenu
menu "chre (/Users/julius/zephyrproject/modules/lib/chre)"
osource "/Users/julius/zephyrproject/modules/lib/chre/platform/zephyr/Kconfig"
config ZEPHYR_CHRE_MODULE
	bool
	default y
endmenu
menu "fatfs (/Users/julius/zephyrproject/modules/fs/fatfs)"
osource "$(ZEPHYR_FATFS_KCONFIG)"
config ZEPHYR_FATFS_MODULE
	bool
	default y
endmenu
menu "hal_espressif (/Users/julius/zephyrproject/modules/hal/espressif)"
osource "/Users/julius/zephyrproject/modules/hal/espressif/zephyr/Kconfig"
config ZEPHYR_HAL_ESPRESSIF_MODULE
	bool
	default y
endmenu
menu "hal_ethos_u (/Users/julius/zephyrproject/modules/hal/ethos_u)"
osource "$(ZEPHYR_HAL_ETHOS_U_KCONFIG)"
config ZEPHYR_HAL_ETHOS_U_MODULE
	bool
	default y
endmenu
menu "hal_gigadevice (/Users/julius/zephyrproject/modules/hal/gigadevice)"
osource "$(ZEPHYR_HAL_GIGADEVICE_KCONFIG)"
config ZEPHYR_HAL_GIGADEVICE_MODULE
	bool
	default y
endmenu
menu "hal_infineon (/Users/julius/zephyrproject/modules/hal/infineon)"
osource "$(ZEPHYR_HAL_INFINEON_KCONFIG)"
config ZEPHYR_HAL_INFINEON_MODULE
	bool
	default y
endmenu
menu "hal_nordic (/Users/julius/zephyrproject/modules/hal/nordic)"
osource "$(ZEPHYR_HAL_NORDIC_KCONFIG)"
config ZEPHYR_HAL_NORDIC_MODULE
	bool
	default y
endmenu
menu "hal_nxp (/Users/julius/zephyrproject/modules/hal/nxp)"
osource "$(ZEPHYR_HAL_NXP_KCONFIG)"
config ZEPHYR_HAL_NXP_MODULE
	bool
	default y
endmenu
menu "hal_rpi_pico (/Users/julius/zephyrproject/modules/hal/rpi_pico)"
osource "$(ZEPHYR_HAL_RPI_PICO_KCONFIG)"
config ZEPHYR_HAL_RPI_PICO_MODULE
	bool
	default y
endmenu
menu "hal_telink (/Users/julius/zephyrproject/modules/hal/telink)"
osource "/Users/julius/zephyrproject/modules/hal/telink/Kconfig"
config ZEPHYR_HAL_TELINK_MODULE
	bool
	default y
endmenu
menu "liblc3 (/Users/julius/zephyrproject/modules/lib/liblc3)"
osource "$(ZEPHYR_LIBLC3_KCONFIG)"
config ZEPHYR_LIBLC3_MODULE
	bool
	default y
endmenu
menu "littlefs (/Users/julius/zephyrproject/modules/fs/littlefs)"
osource "$(ZEPHYR_LITTLEFS_KCONFIG)"
config ZEPHYR_LITTLEFS_MODULE
	bool
	default y
endmenu
menu "loramac-node (/Users/julius/zephyrproject/modules/lib/loramac-node)"
osource "$(ZEPHYR_LORAMAC_NODE_KCONFIG)"
config ZEPHYR_LORAMAC_NODE_MODULE
	bool
	default y
endmenu
menu "lvgl (/Users/julius/zephyrproject/modules/lib/gui/lvgl)"
osource "/Users/julius/zephyrproject/modules/lib/gui/lvgl/zephyr/Kconfig"
config ZEPHYR_LVGL_MODULE
	bool
	default y
endmenu
menu "lz4 (/Users/julius/zephyrproject/modules/lib/lz4)"
osource "$(ZEPHYR_LZ4_KCONFIG)"
config ZEPHYR_LZ4_MODULE
	bool
	default y
endmenu
menu "mbedtls (/Users/julius/zephyrproject/modules/crypto/mbedtls)"
osource "$(ZEPHYR_MBEDTLS_KCONFIG)"
config ZEPHYR_MBEDTLS_MODULE
	bool
	default y
endmenu
menu "nanopb (/Users/julius/zephyrproject/modules/lib/nanopb)"
osource "$(ZEPHYR_NANOPB_KCONFIG)"
config ZEPHYR_NANOPB_MODULE
	bool
	default y
endmenu
menu "openthread (/Users/julius/zephyrproject/modules/lib/openthread)"
osource "$(ZEPHYR_OPENTHREAD_KCONFIG)"
config ZEPHYR_OPENTHREAD_MODULE
	bool
	default y
endmenu
menu "picolibc (/Users/julius/zephyrproject/modules/lib/picolibc)"
osource "/Users/julius/zephyrproject/modules/lib/picolibc/zephyr/Kconfig"
config ZEPHYR_PICOLIBC_MODULE
	bool
	default y
endmenu
menu "sof (/Users/julius/zephyrproject/modules/audio/sof)"
osource "/Users/julius/zephyrproject/modules/audio/sof/zephyr/Kconfig"
config ZEPHYR_SOF_MODULE
	bool
	default y
endmenu
menu "tflite-micro (/Users/julius/zephyrproject/modules/lib/tflite-micro)"
osource "$(ZEPHYR_TFLITE_MICRO_KCONFIG)"
config ZEPHYR_TFLITE_MICRO_MODULE
	bool
	default y
endmenu
menu "TraceRecorder (/Users/julius/zephyrproject/modules/debug/TraceRecorder)"
osource "/Users/julius/zephyrproject/modules/debug/TraceRecorder/kernelports/Zephyr/Kconfig"
config ZEPHYR_TRACERECORDER_MODULE
	bool
	default y
endmenu
menu "trusted-firmware-m (/Users/julius/zephyrproject/modules/tee/tf-m/trusted-firmware-m)"
osource "$(ZEPHYR_TRUSTED_FIRMWARE_M_KCONFIG)"
config ZEPHYR_TRUSTED_FIRMWARE_M_MODULE
	bool
	default y
endmenu
menu "trusted-firmware-a (/Users/julius/zephyrproject/modules/tee/tf-a/trusted-firmware-a)"
osource "$(ZEPHYR_TRUSTED_FIRMWARE_A_KCONFIG)"
config ZEPHYR_TRUSTED_FIRMWARE_A_MODULE
	bool
	default y
endmenu
menu "uoscore-uedhoc (/Users/julius/zephyrproject/modules/lib/uoscore-uedhoc)"
osource "$(ZEPHYR_UOSCORE_UEDHOC_KCONFIG)"
config ZEPHYR_UOSCORE_UEDHOC_MODULE
	bool
	default y
endmenu
menu "zcbor (/Users/julius/zephyrproject/modules/lib/zcbor)"
osource "$(ZEPHYR_ZCBOR_KCONFIG)"
config ZEPHYR_ZCBOR_MODULE
	bool
	default y
endmenu
menu "zscilib (/Users/julius/zephyrproject/modules/lib/zscilib)"
osource "/Users/julius/zephyrproject/modules/lib/zscilib/Kconfig.zscilib"
config ZEPHYR_ZSCILIB_MODULE
	bool
	default y
endmenu
menu "thrift (/Users/julius/zephyrproject/modules/lib/thrift)"
osource "$(ZEPHYR_THRIFT_KCONFIG)"
config ZEPHYR_THRIFT_MODULE
	bool
	default y
endmenu
```
